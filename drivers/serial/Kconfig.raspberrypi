## drivers/serial/Kconfig.raspberrypi
```kconfig
# Copyright (c) 2021 Yonatan Schachter
# SPDX-License-Identifier: Apache-2.0

config UART_RASPBERRYPI
	bool "Raspberry Pi UART driver"
	select SERIAL_HAS_DRIVER

menuconfig UART_PIO_RASPBERRYPI
	bool "Raspberry Pi PIO based UART driver"
	select SERIAL_HAS_DRIVER
	select SERIAL_SUPPORT_ASYNC

# if UART_PIO_RASPBERRYPI

# choice
# 	default UART_PIO_RASPBERRYPI_RX

# 	config UART_PIO_RASPBERRYPI_RX
# 		bool "RX only"

# 	config UART_PIO_RASPBERRYPI_TX
# 		bool "TX only"

# 	config UART_PIO_RASPBERRYPI_RX_TX
# 		bool "RX+TX (half-duplex)"

# endchoice

# endif
```

## dts/bindings/serial/raspberrypi,rp2-pio-uart.yaml
```yaml
description: Raspberry Pi PIO based UART (half-duplex)

compatible: "raspberrypi,rp2-pio-uart"

include: uart-controller.yaml

properties:
    pio:
      type: int
      required: true

#    interrupts:
#      required: true

    pin:
      type: int
      required: true
      description: TX/RX pin as a GPIO number
```

## dts/bindings/usb/raspberrypi,rp2-usbd.yaml
```yaml
# Copyright (c) 2021, Pete Johanson
# SPDX-License-Identifier: Apache-2.0

description: RP2 USB Controller

compatible: "raspberrypi,rp2-usbd"

include: usb-ep.yaml

properties:
    reg:
      required: true

    interrupts:
      required: true
```
